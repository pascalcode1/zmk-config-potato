## config/boards/shields/potato/Kconfig.defconfig
```kconfig
if SHIELD_POTATO_LEFT || SHIELD_POTATO_RIGHT

config ZMK_KEYBOARD_NAME
    default "potato"

endif
```

## config/boards/shields/potato/Kconfig.devconfig
```kconfig
if SHIELD_POTATO

config ZMK_KEYBOARD_NAME
    default "potato"

config ZMK_BLE
    default y

endif
```

## config/boards/shields/potato/Kconfig.shield
```kconfig
config SHIELD_POTATO_LEFT
    def_bool $(shields_list_contains,potato_left)

config SHIELD_POTATO_RIGHT
    def_bool $(shields_list_contains,potato_right)
```
